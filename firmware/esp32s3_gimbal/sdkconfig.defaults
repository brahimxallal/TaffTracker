## firmware/esp32s3_gimbal/sdkconfig.defaults
```kconfig
CONFIG_FREERTOS_UNICORE=n
CONFIG_FREERTOS_HZ=1000
CONFIG_FREERTOS_USE_TICKLESS_IDLE=n
CONFIG_COMPILER_OPTIMIZATION_PERF=y
CONFIG_ESP_SYSTEM_PANIC_PRINT_REBOOT=y
CONFIG_ESPTOOLPY_FLASHSIZE_16MB=y
CONFIG_SPIRAM=y
CONFIG_SPIRAM_MODE_OCT=y
CONFIG_SPIRAM_SPEED_80M=y
CONFIG_SPIRAM_ALLOW_BSS_SEG_EXTERNAL_MEMORY=n
CONFIG_SPIRAM_ALLOW_STACK_EXTERNAL_MEMORY=n
# 240 MHz CPU for minimum control loop jitter
CONFIG_ESP_DEFAULT_CPU_FREQ_MHZ_240=y
# Pin esp_timer task to Core 1 (control loop isolation)
CONFIG_ESP_TIMER_SHOW_EXPERIMENTAL=y
CONFIG_ESP_TIMER_TASK_AFFINITY_CPU1=y
CONFIG_ESP_TIMER_ISR_AFFINITY_CPU1=y
# Disable USB Serial/JTAG as secondary console (prevents debug text mixing with binary packets)
CONFIG_ESP_CONSOLE_SECONDARY_NONE=y
# Route ESP_LOG to USB Serial/JTAG so logs appear on native USB COM port
CONFIG_ESP_CONSOLE_USB_SERIAL_JTAG=y
```
